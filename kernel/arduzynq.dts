/ {
	aliases {
		serial1 = "/amba/serial@e0000000";
	};

	memory@0 {
		device_type = "memory";
		reg = < 0x00 0x20000000 >;
	};

    chosen {
        seL4,elfloader-devices =
            "serial1",
            &{/amba/slcr@f8000000/rstc@200};
        seL4,kernel-devices =
            "serial1",
            &{/amba/interrupt-controller@f8f01000},
            &{/amba/cache-controller@f8f02000},
            &{/amba/timer@f8f00200};
    };
};
